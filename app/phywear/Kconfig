## app/phywear/Kconfig
```kconfig
#
# For a description of the syntax of this configuration file,
# see the file kconfig-language.txt in the NuttX tools repository.
#

menuconfig EXAMPLES_PHYWEAR
	tristate "PhyWear sensor display"
	default n
	depends on GRAPHICS_LVGL
	---help---
		Enable the PhyWear wrist physics-lab sensor display app.
		Reads IMU/magnetometer/ambient-light and shows values on LVGL cards.

if EXAMPLES_PHYWEAR

config EXAMPLES_PHYWEAR_PRIORITY
	int "phywear task priority"
	default 100

config EXAMPLES_PHYWEAR_STACKSIZE
	int "phywear stack size"
	default 16384

config EXAMPLES_PHYWEAR_SIM
	bool "phywear simulator mode (tolerate missing sensor devices)"
	default n
	---help---
		Run the GUI even when /dev/lsm6dsl0|mag0|light0 are absent (openvela
		emulator has no sensor drivers).  Missing sensors show placeholder
		values; used for i18n/visual acceptance only - keep off on device.

config EXAMPLES_PHYWEAR_SIM_ZH_DEMO
	bool "phywear simulator: force Chinese + auto-demo for screenshot"
	default n
	depends on EXAMPLES_PHYWEAR_SIM
	---help---
		Emulator-only flag for screenshot capture.  Forces pw_i18n_set_zh(true)
		and enables demo auto-navigation (root->raw/mech/tool/time/every->about)
		so every page can be captured from /dev/fb0 without interactive input.
		Must be OFF on real device.

# [AGENT-WIN11] 上电自启开关：由板级 board_late_initialize() 拉起 PhyWear，
# 不再需要插 USB 串口、手敲 `phywear` 才能出界面。
config EXAMPLES_PHYWEAR_AUTOSTART
	bool "start phywear automatically at boot"
	default n
	depends on BOARD_LATE_INITIALIZE
	---help---
		Start the PhyWear GUI from board_late_initialize() so the device
		boots straight into the watch UI without an NSH command or a USB
		serial console attached.

config EXAMPLES_PHYWEAR_AUTOSTART_KEY2_SKIP
	bool "hold KEY2 at boot to skip autostart"
	default n
	depends on EXAMPLES_PHYWEAR_AUTOSTART
	---help---
		Read KEY2 (PA_43) in board_late_initialize() and skip the autostart
		when it is held, so the board stays in NSH for debugging.

		Enable only after confirming PA43 is not muxed onto the LCD 8080
		bus in the active board configuration.

# [AGENT-WIN11] 开机动画：上电后先放 logo + 进度条，覆盖 LCD 点亮到首帧的黑屏
config EXAMPLES_PHYWEAR_SPLASH
	bool "show boot splash before the main UI"
	default y
	---help---
		Play a short LVGL splash (wordmark + progress bar) after the display
		is up and before the main UI is created.  Pure vector drawing, no
		image assets; costs about 1.8 s of boot time.

# [AGENT-WIN11] 电源模块：VBAT 电量、VBUS_DET 充电检测、背光/息屏
config EXAMPLES_PHYWEAR_POWER
	bool "power monitor (battery / charger / backlight)"
	default y
	---help---
		Read battery voltage from /dev/adc0 (the adc driver is bound to
		ADC_CHAN_VBAT), detect charging via VBUS_DET on PA_44, and control
		the backlight through /dev/lcdlight (0 = screen off).

if EXAMPLES_PHYWEAR_POWER

config EXAMPLES_PHYWEAR_POWER_BL_ON
	int "backlight level when screen wakes (0-100)"
	default 50
	range 1 100

endif # EXAMPLES_PHYWEAR_POWER

endif # EXAMPLES_PHYWEAR
```
